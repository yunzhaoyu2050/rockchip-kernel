## drivers/rongpin/Kconfig
```kconfig
menu "rongpin support"

config POWER_EN
	tristate "rongpin power_en support"
        default y
        help
	  
config LED_GPIO
	tristate "led gpio support"
	default y
	help
		Generic rpdzkj power off
config RP_CONFIG
	tristate "rpdzkj config"
	default y
	help
		rpdzkj config
config RP_GPIO
        tristate "rp gpio driver"
        default y
        help
          Say yes here to build support for "rp_gpio.c".
endmenu
```
